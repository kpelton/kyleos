## extras/busybox-kyleos/defconfig
```kconfig
CONFIG_HAVE_DOT_CONFIG=y
CONFIG_LONG_OPTS=y
CONFIG_SHOW_USAGE=y
CONFIG_BUSYBOX=y
CONFIG_FEATURE_VERSION=y
CONFIG_STATIC=y
CONFIG_USE_PORTABLE_CODE=y
CONFIG_BUSYBOX_EXEC_PATH="/bin/busybox"
CONFIG_EXTRA_LDLIBS=":libbusybox-kyleos.a :libc.a"
CONFIG_INSTALL_APPLET_SYMLINKS=y
CONFIG_FEATURE_BUFFERS_USE_MALLOC=y
CONFIG_FEATURE_COPYBUF_KB=4

CONFIG_CAT=y
CONFIG_ECHO=y
CONFIG_FEATURE_FANCY_ECHO=y
CONFIG_ENV=y
CONFIG_FALSE=y
CONFIG_HEAD=y
CONFIG_LS=y
CONFIG_MKDIR=y
CONFIG_PRINTENV=y
CONFIG_PRINTF=y
CONFIG_PWD=y
CONFIG_RM=y
CONFIG_RMDIR=y
CONFIG_SLEEP=y
CONFIG_TAIL=y
CONFIG_TEST=y
CONFIG_TEST1=y
CONFIG_TRUE=y
CONFIG_WC=y
CONFIG_GREP=y

# Compression and archive utilities
CONFIG_GZIP=y
CONFIG_GUNZIP=y
CONFIG_BZIP2=y
CONFIG_BUNZIP2=y
CONFIG_XZ=y
CONFIG_UNXZ=y
CONFIG_TAR=y
CONFIG_FEATURE_TAR_CREATE=y
CONFIG_FEATURE_SEAMLESS_GZ=y
CONFIG_FEATURE_SEAMLESS_BZ2=y
CONFIG_FEATURE_SEAMLESS_XZ=y
CONFIG_UNZIP=y
CONFIG_CPIO=y
CONFIG_HEXDUMP=y
CONFIG_HD=y

CONFIG_VI=y
CONFIG_FEATURE_VI_MAX_LEN=4096
CONFIG_FEATURE_VI_COLON=y
CONFIG_FEATURE_VI_COLON_EXPAND=y
CONFIG_FEATURE_VI_YANKMARK=y
CONFIG_FEATURE_VI_SEARCH=y
CONFIG_FEATURE_VI_DOT_CMD=y
CONFIG_FEATURE_VI_READONLY=y
CONFIG_FEATURE_VI_SETOPTS=y
CONFIG_FEATURE_VI_SET=y
CONFIG_FEATURE_VI_WIN_RESIZE=y
CONFIG_FEATURE_VI_UNDO=y
CONFIG_FEATURE_VI_UNDO_QUEUE=y
CONFIG_FEATURE_VI_UNDO_QUEUE_MAX=256
CONFIG_FEATURE_VI_VERBOSE_STATUS=y

CONFIG_SH_IS_ASH=y
CONFIG_BASH_IS_NONE=y
CONFIG_ASH=y
CONFIG_ASH_OPTIMIZE_FOR_SIZE=y
CONFIG_ASH_INTERNAL_GLOB=y
CONFIG_ASH_BASH_COMPAT=y
CONFIG_ASH_JOB_CONTROL=y
CONFIG_ASH_ALIAS=y
CONFIG_ASH_ECHO=y
CONFIG_ASH_PRINTF=y
CONFIG_ASH_TEST=y
CONFIG_ASH_GETOPTS=y
CONFIG_ASH_CMDCMD=y
CONFIG_FEATURE_SH_MATH=y
CONFIG_FEATURE_SH_EXTRA_QUIET=y
CONFIG_FEATURE_SH_STANDALONE=y
```
